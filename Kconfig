## Kconfig
```kconfig
menuconfig THINGSBOARD
    bool "Thingsboard library"
    depends on NETWORKING
    depends on NET_IPV4
    depends on NET_SOCKETS
    depends on JSON_LIBRARY
    depends on COAP
    select NET_SOCKETS_POSIX_NAMES

if THINGSBOARD

config COAP_CLIENT_NUM_MSGS
    int "Maximum number of CoAP messages"
    default 10

config COAP_CLIENT_STAT_INTERVAL_SECONDS
    int "Interval in seconds between stat printouts"
    default 30 if LOG
    default 0
    help
      Prints out statistics about resource usage on a regular interval.
      Set to 0 to deactivate.

config COAP_CLIENT_MSG_LEN
    int "Maximum length of CoAP messages"
    default 1280

config COAP_NUM_RETRIES
    int "Number of retries for CoAP messages"
    default 3

config THINGSBOARD_USE_PROVISIONING
    bool "Provision devices"
    depends on SETTINGS
    depends on FLASH
    depends on FLASH_MAP
    depends on NVS
	default y

config THINGSBOARD_FOTA
    bool "Thingsboard FOTA support"
    depends on DFU_TARGET_MCUBOOT
    depends on REBOOT

if THINGSBOARD_FOTA

config THINGSBOARD_FOTA_CHUNK_SIZE
    int "Chunk size for FOTA updates"
    default 1024
    help
       "Must be smaller than COAP_CLIENT_MSG_LEN"

endif # THINGSBOARD_FOTA

if THINGSBOARD_USE_PROVISIONING

config THINGSBOARD_PROVISIONING_KEY
    string "Provisioning key"

config THINGSBOARD_PROVISIONING_SECRET
    string "Provisioning secret"

endif # THINGSBOARD_USE_PROVISIONING

config THINGSBOARD_ACCESS_TOKEN
  string
  prompt "Device Access Token" if !THINGSBOARD_USE_PROVISIONING
  default ""

config THINGSBOARD_TIME_REFRESH_INTERVAL_SECONDS
    int "Interval in seconds between time refresh"
    default 3600

config COAP_SERVER_HOSTNAME
  string "Coap Server hostname"
  default "10.101.45.222"

config COAP_SERVER_PORT
	int "CoAP server port"
	default 5683

module = THINGSBOARD
module-str = Thingsboard SDK
source "subsys/logging/Kconfig.template.log_config"

endif # THINGSBOARD
```

## tests/compile/testcase.yaml
```yaml
common:
  platform_allow:
    - qemu_cortex_m3
    - native_posix
tests:
  thingsboard.compile:
    extra_configs:
      - CONFIG_THINGSBOARD_TIME_REFRESH_INTERVAL_SECONDS=5
  thingsboard.failure:
    extra_configs:
      - CONFIG_THINGSBOARD_TEST_FAILURE=y
  thingsboard.compile_provisioning:
    build_only: true
    extra_configs:
      - CONFIG_THINGSBOARD_USE_PROVISIONING=y
      - CONFIG_SETTINGS=y
  thingsboard.compile_fota:
    build_only: true
    extra_configs:
      - CONFIG_THINGSBOARD_FOTA=y
```

## west.yml
```yaml
manifest:
  defaults:
    remote: github

  remotes:
    - name: github
      url-base: https://github.com

  projects:
    - name: nrf
      remote: github
      repo-path: nrfconnect/sdk-nrf
      revision: v2.7.0
      path: nrf
      import: true

  self:
    path: modules/thingsboard
```
