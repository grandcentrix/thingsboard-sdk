## CMakeLists.txt
```
# SPDX-License-Identifier: Apache-2.0

cmake_minimum_required(VERSION 3.20.0)
find_package(Zephyr REQUIRED HINTS $ENV{ZEPHYR_BASE})
project(attributes-sample)

target_sources(app PRIVATE src/main.c)

target_compile_options(app PRIVATE
    -Wall
    -Werror
    -Wno-unused-parameter
)

set_property(
    TARGET thingsboard
    APPEND
    PROPERTY JSON_SCHEMAS
    ${CMAKE_CURRENT_SOURCE_DIR}/schema/sample_attr.jsonschema
)
```

## prj.conf
```kconfig
CONFIG_LOG=y

# Cellular connectivity
CONFIG_NRF_MODEM_LIB=y
CONFIG_NRF_MODEM_LIB_LOG_FW_VERSION_UUID=y
CONFIG_LTE_LINK_CONTROL=y
CONFIG_LTE_NETWORK_MODE_LTE_M_NBIOT=y
CONFIG_LTE_MODE_PREFERENCE_LTE_M=y
CONFIG_LTE_PSM_REQ=y
CONFIG_LTE_EDRX_REQ=y
CONFIG_NET_SOCKETS_OFFLOAD=y

# Requirements for Thingsboard SDK
CONFIG_COAP=y
CONFIG_NETWORKING=y
CONFIG_NET_IPV4=y
CONFIG_NET_SOCKETS=y
CONFIG_JSON_LIBRARY=y
CONFIG_FLASH=y
CONFIG_FLASH_MAP=y
CONFIG_NVS=y
CONFIG_SETTINGS=y

# Thingsboard SDK
CONFIG_THINGSBOARD=y
CONFIG_THINGSBOARD_USE_PROVISIONING=n
# Set server name and access token
# CONFIG_COAP_SERVER_HOSTNAME=""
# CONFIG_THINGSBOARD_ACCESS_TOKEN=""
```

## src/main.c
```c
#include <thingsboard.h>
#include <thingsboard_attr_parser.h>

#include <modem/lte_lc.h>
#include <modem/nrf_modem_lib.h>
#include <zephyr/kernel.h>
#include <zephyr/logging/log.h>
#include <zephyr/settings/settings.h>

#include <string.h>

LOG_MODULE_REGISTER(main);

static struct tb_fw_id fw_id = {
	.fw_title = "attributes-sample", .fw_version = "v1.0.0", .device_name = "sample-device"};

void attr_write_callback(struct thingsboard_attr *attr)
{
	if (attr->foo_parsed) {
		LOG_INF("Received value for attribute 'foo' from server: '%s'", attr->foo);
	}
}

int main(void)
{
	int err = 0;

	LOG_INF("Initializing modem library");
	err = nrf_modem_lib_init();
	if (err) {
		LOG_ERR("Failed to initialize the modem library, error (%d): %s", err,
			strerror(-err));
		return err;
	}

	err = lte_lc_func_mode_set(LTE_LC_FUNC_MODE_ACTIVATE_LTE);
	if (err) {
		LOG_ERR("Failed to activate LTE");
		return err;
	}

	LOG_INF("Connecting to LTE network");
	err = lte_lc_connect();
	if (err) {
		LOG_ERR("Could not establish LTE connection, error (%d): %s", err, strerror(-err));
		return err;
	}
	LOG_INF("LTE connection established");

	LOG_INF("Connecting to Thingsboards");
	err = thingsboard_init(&attr_write_callback, &fw_id);
	if (err) {
		LOG_ERR("Could not initialize thingsboard connection, error (%d) :%s", err,
			strerror(-err));
		return err;
	}
}
```
