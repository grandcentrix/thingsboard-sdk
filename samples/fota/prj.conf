## CMakeLists.txt
```
# SPDX-License-Identifier: Apache-2.0

cmake_minimum_required(VERSION 3.20.0)
find_package(Zephyr REQUIRED HINTS $ENV{ZEPHYR_BASE})
project(fota-sample)

target_sources(app PRIVATE src/main.c)

target_compile_options(app PRIVATE
    -Wall
    -Werror
    -Wno-unused-parameter
)
```

## prj.conf
```kconfig
CONFIG_LOG=y

# Cellular connectivity
CONFIG_NRF_MODEM_LIB=y
CONFIG_NRF_MODEM_LIB_LOG_FW_VERSION_UUID=y
CONFIG_LTE_LINK_CONTROL=y
CONFIG_LTE_NETWORK_MODE_LTE_M_NBIOT=y
CONFIG_LTE_MODE_PREFERENCE_LTE_M=y
CONFIG_LTE_PSM_REQ=y
CONFIG_LTE_EDRX_REQ=y
CONFIG_NET_SOCKETS_OFFLOAD=y

# Requirements for Thingsboard SDK
CONFIG_COAP=y
CONFIG_NETWORKING=y
CONFIG_NET_IPV4=y
CONFIG_NET_SOCKETS=y
CONFIG_JSON_LIBRARY=y
CONFIG_FLASH=y
CONFIG_FLASH_MAP=y
CONFIG_NVS=y
CONFIG_SETTINGS=y

# mcuboot and DFU (needed for FOTA)
CONFIG_BOOTLOADER_MCUBOOT=y
CONFIG_STREAM_FLASH=y
CONFIG_STREAM_FLASH_ERASE=y
CONFIG_IMG_MANAGER=y
CONFIG_DFU_TARGET=y
CONFIG_DFU_TARGET_MCUBOOT=y
CONFIG_REBOOT=y

# Thingsboard SDK
CONFIG_THINGSBOARD=y
CONFIG_THINGSBOARD_USE_PROVISIONING=n
CONFIG_THINGSBOARD_FOTA=y
# Set server name and access token
# CONFIG_COAP_SERVER_HOSTNAME=""
# CONFIG_THINGSBOARD_ACCESS_TOKEN=""
```

## src/main.c
```c
#include <thingsboard.h>

#include <modem/lte_lc.h>
#include <modem/nrf_modem_lib.h>
#include <zephyr/kernel.h>
#include <zephyr/logging/log.h>
#include <zephyr/settings/settings.h>

#include <string.h>

LOG_MODULE_REGISTER(main);

static struct tb_fw_id fw_id = {.fw_title = "thingsboard-sdk-fota-sample",
				.fw_version = "1",
				.device_name = "sample-device"};

int main(void)
{
	int err = 0;

	LOG_INF("Initializing modem library");
	err = nrf_modem_lib_init();
	if (err) {
		LOG_ERR("Failed to initialize the modem library, error (%d): %s", err,
			strerror(-err));
		return err;
	}

	err = lte_lc_func_mode_set(LTE_LC_FUNC_MODE_ACTIVATE_LTE);
	if (err) {
		LOG_ERR("Failed to activate LTE");
		return err;
	}

	LOG_INF("Connecting to LTE network");
	err = lte_lc_connect();
	if (err) {
		LOG_ERR("Could not establish LTE connection, error (%d): %s", err, strerror(-err));
		return err;
	}
	LOG_INF("LTE connection established");

	LOG_INF("Connecting to Thingsboards");
	err = thingsboard_init(NULL, &fw_id);
	if (err) {
		LOG_ERR("Could not initialize thingsboard connection, error (%d) :%s", err,
			strerror(-err));
		return err;
	}
}
```
